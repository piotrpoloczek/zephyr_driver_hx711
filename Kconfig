## Kconfig
```kconfig
config HX711
    bool "HX711 Load Cell Amplifier"
    default y
    depends on DT_HAS_HX711_ENABLED
    help
      Enable driver for HX711 load cell amplifier.
```

## drivers/sensor/hx711/Kconfig
```kconfig
# HX711 Weight Scale interface Sensor configuration options
# Copyright (c) 2020 George Gkinis
# Copyright (c) 2021 Jan Gnip
# SPDX-License-Identifier: Apache-2.0

menuconfig HX711
	bool "HX711 Weight Scale Sensor"
	depends on GPIO
	help
	  Enable driver for the HX711 Weight Scale Sensor.

if HX711

config HX711_OFFSET
	int "Initial Offset"
	default 0
	help
	  Sensor offset.

config HX711_SLOPE_INTEGER
	int "Initial Slope. Integer part."
	default 1
	help
	  Sensor slope, integer part.

config HX711_SLOPE_DECIMAL
	int "Initial Slope. Decimal part."
	default 0
	help
	  Sensor slope, decimal part.

config HX711_CALIBRATION_WEIGHT
	int "Calibration weight."
	default 0
	help
	  Known weight for calibration purposes.

choice
	prompt "HX711 sampling rate"
	default HX711_RATE_10HZ
	help
	  Select sampling rate.
config HX711_RATE_10HZ
	bool "10Hz"
config HX711_RATE_80HZ
	bool "80Hz"
endchoice

config HX711_SAMPLING_RATE
	int "HX711 sampling rate"
	default 0
	default 0 if HX711_RATE_10HZ
	default 1 if HX711_RATE_80HZ

choice
	prompt "HX711 gain"
	default HX711_GAIN_128X
	help
	  Select HX711 gain.
config HX711_GAIN_32X
	bool "32x"
config HX711_GAIN_64X
	bool "64x"
config HX711_GAIN_128X
	bool "128x"
endchoice

config HX711_DISABLE_INTERRUPTS_WHILE_POLLING
	bool "Disable interrupts while polling"
	help
	  Disable interrupts while polling for data.

config HX711_GAIN
	int
	default 1
	default 1 if HX711_GAIN_128X
	default 2 if HX711_GAIN_32X
	default 3 if HX711_GAIN_64X

# Filter configuration
config HX711_ENABLE_EMA_FILTER
	bool "Enable EMA filter"
	default n
	help
	  Enable Exponential Moving Average filter for HX711 sensor readings.

config HX711_EMA_FILTER_ALPHA_FACTOR
	int "EMA filter alpha factor (0-100)"
	depends on HX711_ENABLE_EMA_FILTER
	range 0 100
	default 50
	help
	  EMA filter smoothing factor (0-100). Lower values = more smoothing.

config HX711_ENABLE_MEDIAN_FILTER
	bool "Enable Median filter"
	default n
	help
	  Enable Median filter for HX711 sensor readings.

config HX711_MEDIAN_FILTER_WINDOW_SIZE
	int "Median filter window size"
	depends on HX711_ENABLE_MEDIAN_FILTER
	range 3 15
	default 3
	help
	  Number of samples to use for median calculation. Must be odd for best results.

config HX711_ENABLE_SPIKE_FILTER
	bool "Enable Spike filter"
	default n
	help
	  Enable Spike filter to detect and reject sudden weight spikes.

config HX711_SPIKE_FILTER_THRESHOLD
	int "Spike filter threshold (grams)"
	depends on HX711_ENABLE_SPIKE_FILTER
	range 1 1000
	default 51
	help
	  Weight threshold in grams above which readings are considered spikes.

endif # HX711
```

## dts/bindings/sensor/avia,hx711.yaml
```yaml
compatible: "my,hx711"
description: HX711 Load Cell Amplifier
include: base.yaml

properties:
  dout-gpios:
    type: phandle-array
    required: true
    description: Data output pin

  sck-gpios:
    type: phandle-array
    required: true
    description: Shared clock pin
```

## dts/bindings/sensor/hx711.yaml
```yaml
description: HX711 Load Cell Amplifier
compatible: "hx711"
include: base.yaml

properties:
  data-gpios:
    type: phandle-array
    required: true
  clk-gpios:
    type: phandle-array
    required: true
  gain:
    type: int
    required: false
    default: 128
  mode:
    type: int
    required: false
    default: 0
```
